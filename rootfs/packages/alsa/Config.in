## rootfs/packages/alsa/Config.in
```kconfig
config PACKAGE_ALSA_LIB
    bool "ALSA library"
    default n
    help
      ALSA provides audio and MIDI functionality to the Linux operating system.
      User space library (alsa-lib) to simplify application programming
      and provide higher level functionality.
```

## rootfs/packages/fakeroot/Config.in
```kconfig
config PACKAGE_FAKEROOT
	bool "fakeroot"
	default y
	help
	  Run commands in an environment faking root privileges.

	  http://joostje.op.het.net/fakeroot/
```

## rootfs/packages/fontconfig/Config.in
```kconfig
config PACKAGE_FONTCONFIG
	bool "fontconfig"
	select PACKAGE_FREETYPE
	default y
	help

	http://www.fontconfig.org/
```

## rootfs/packages/fonts/Config.in
```kconfig
config PACKAGE_FONTS
	bool "extra_fonts"
	default y
	help
	 Install additional fonts into the image
	 Place your fonts in dl/fonts/ directory
```

## rootfs/packages/glib/Config.in
```kconfig
config PACKAGE_GLIB
	bool "glib"
	default y
	help
	  Low-level core library that forms the basis of GTK+ and GNOME.

	  http://www.gtk.org/
```

## rootfs/packages/libid3tag/Config.in
```kconfig
config PACKAGE_LIBID3TAG 
    bool "ID3 tag manipulation library"
    default n
    help
      the libid3tag lib is used by mp3 players to get the metadata of the mp3 file.
```

## rootfs/packages/libmad/Config.in
```kconfig
config PACKAGE_LIBMAD
        bool "MPEG Audio Decoder library "
        default y
        help
          the library supports MPEG-1 and the MPEG-2 extension to lower sampling frequencies,
          as well as the de facto MPEG 2.5 format. All three audio layers -- Layer I, Layer II,
          and Layer III (i.e. MP3) -- are fully implemented.
```

## rootfs/packages/libmpdclient/Config.in
```kconfig
config PACKAGE_LIBMPDCLIENT
	bool "MPD Client Library"
	default y
	help
	  A asynchronous API library for interfacing MPD
	  in the C, C++ & Objective C languages.
```

## rootfs/packages/mpd/Config.in
```kconfig
config PACKAGE_MPD
	bool "Music Player Daemon (MPD)"
	default y
	help
	  Music Player Daemon is a flexible, powerful,
	  server-side application for playing music.
```

## rootfs/packages/ntpclient/Config.in
```kconfig
config PACKAGE_NTPCLIENT
	bool "Network Time Protocol (NTP) client"
	default y
	help
	  ntpclient is an NTP (RFC-1305) client for unix-alike computers.
```

## rootfs/packages/obx/Config.in
```kconfig
config PACKAGE_OBX_EXPLORER
	bool "obx_explorer"
	default y
	help
	 OpenBOOX Explorer
```

## rootfs/packages/poppler/Config.in
```kconfig
config PACKAGE_POPPLER
	bool "poppler"
	default y
	help
	 poppler is a PDF rendering library based on the xpdf-3.0 code base
```

## rootfs/packages/qtmpdclient/Config.in
```kconfig
config PACKAGE_QTMPDCLIENT
	bool "QtMpdClient"
	default y
	help
	 QtMpdClient is a Qt wrapper library for libmpdclient
```

## rootfs/packages/quazip/Config.in
```kconfig
config PACKAGE_QUAZIP
	bool "quazip"
	default y
	help
	 QuaZIP is a simple C++ wrapper over Gilles Vollant's ZIP/UNZIP package
	 that can be used to access ZIP archives
```
